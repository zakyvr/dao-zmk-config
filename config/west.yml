## config/west.yml
```yaml
manifest:
  remotes:
    - name: zmkfirmware
      url-base: https://github.com/zmkfirmware
  projects:
    - name: zmk
      remote: zmkfirmware
      revision: fee2404d5d886c455e3820f9ca624cf9275e9cb5
      import: app/west.yml
  self:
    path: config
```
